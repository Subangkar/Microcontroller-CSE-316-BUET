#include<stdio.h>
#include<stdint.h>
#include<math.h>
#define N_SAMPLE_POINTS 32
//#define N_SAMPLE_POINTS N_SAMPLE_POINTS
#define SAMPLING_FREQ 20000 // 20KHz








#define REAL 0
#define IMG 1
const int16_t cos_lookup[]= {
	10000,9998,9993,9986,9975,9961,9945,9925,9902,
	9876,9848,9816,9781,9743,9702,9659,9612,9563,
	9510,9455,9396,9335,9271,9205,9135,9063,8987,
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	9876,9902,9925,9945,9961,9975,9986,9993,9998
};

const int16_t sin_lookup[]= {
	0,174,348,523,697,871,1045,1218,1391,
	1564,1736,1908,2079,2249,2419,2588,2756,2923,
	3090,3255,3420,3583,3746,3907,4067,4226,4383,
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	-1564,-1391,-1218,-1045,-871,-697,-523,-348,-174
};

const uint8_t degree_lookup[]= {
	0,0,0,0,0,0,0,0,0,0,0,0,0,0,0,
	0,0,0,0,0,0,0,0,0,0,0,0,0,0,0,
	0,0,0,5,11,16,22,28,33,39,45,50,56,61,67,
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	11,95
};

int32_t analogTimeBuff[N_SAMPLE_POINTS];
int32_t Pc[N_SAMPLE_POINTS/2][2];
int32_t P[N_SAMPLE_POINTS];
// mapped to int
void DFT()
{
	int16_t count,degree;
	uint8_t u,k;
	count = 0;
	for (u=0; u<N_SAMPLE_POINTS/2; u++) {
		for (k=0; k<N_SAMPLE_POINTS; k++) {
			degree = degree_lookup[count]*2;
			count++;
			Pc[u][REAL] +=  analogTimeBuff[k] * cos_lookup[degree];
			Pc[u][IMG] += -analogTimeBuff[k] * sin_lookup[degree];
		}
		Pc[u][REAL] /= N_SAMPLE_POINTS;
		Pc[u][REAL] /= 10000;
		Pc[u][IMG] /= N_SAMPLE_POINTS;
		Pc[u][IMG] /= 10000;
	}
 	for (u=1; u<N_SAMPLE_POINTS/2; u++) {
        if(Pc[u][0]<0)Pc[u][REAL]*=-1;
        if(Pc[u][1]<0)Pc[u][IMG]*=-1;
        P[u] = (Pc[u][REAL] + Pc[u][IMG])/4;//(uint8_t)
    }
}

#define PI2 6.283185307
int16_t f(double t)
{
    float fltVal = 2.5+2.5*sin(PI2*9500*t)+1.5*sin(PI2*7000*t);//+2*sin(PI2*8000*t)+2.5*sin(PI2*9000*t)+2.5*sin(PI2*3000*t)+2.5*cos(PI2*1500*t);
    return (int16_t)(fltVal/0.01953125);
}

uint8_t lcd_buf1[16];
uint8_t lcd_buf2[16];
int main()
{
    float sample_period = 1/(float)SAMPLING_FREQ;

    uint8_t mag;
	int i;
    for(i=0;i<N_SAMPLE_POINTS;i++) {
        analogTimeBuff[i] = f(sample_period*i);
        // printf("%d ",analogTimeBuff[i]);
    }
    DFT();

    for(i = 1; i<N_SAMPLE_POINTS/2; i++) {
        // if(Pc[i][0]<0)Pc[i][REAL]*=-1;
        // if(Pc[i][1]<0)Pc[i][IMG]*=-1;
        // P[i] = mag = (uint8_t)(Pc[i][REAL] + Pc[i][IMG])/4;
        // if((mag)>7) {
        //     lcd_buf1[i] = (mag) - 7 - 1;
        //     if(lcd_buf1[i] > 7)
        //     lcd_buf1[i] = 7;
        //     lcd_buf2[i] = 7;
        // }
        // else {
        //     lcd_buf1[i] = ' ';
        //     lcd_buf2[i] = mag;
        // }
    }
    int n,k;
    // Output results to MATLAB / Octave M-file for plotting
    FILE *f = fopen("dftVinu.m", "w");
    fprintf(f, "clear all\n");
   // fprintf(f, "n = [0:%d];\n", N_SAMPLE_POINTS-1);
    fprintf(f, "xre = [ ");
    for (n=0 ; n<N_SAMPLE_POINTS ; ++n) fprintf(f, "%d ", analogTimeBuff[n]);
    fprintf(f, "];\n");

    // fprintf(f, "Pre = [ ");
    // for (k=0 ; k<N_SAMPLE_POINTS ; ++k) fprintf(f, "%f ", Pre[k]);
    // fprintf(f, "];\n");
    // fprintf(f, "Pim = [ ");
    // for (k=0 ; k<N_SAMPLE_POINTS ; ++k) fprintf(f, "%f ", Pim[k]);
    // fprintf(f, "];\n");
    fprintf(f, "P = [ ");
    for (k=0 ; k<N_SAMPLE_POINTS ; ++k) fprintf(f, "%d ", P[k]);
    fprintf(f, "];\n");
    // fprintf(f,"P=P/%d;\n",N_SAMPLE_POINTS);
    // fprintf(f,"P(2:end-1) = 2*P(2:end-1);\n");
    // fprintf(f, "subplot(3,1,1)\n");
    fprintf(f,"t = linspace(0,%f,%d);\n",sample_period,N_SAMPLE_POINTS); // Fs/2 ,L/2 
    fprintf(f,"f = linspace(0,%d,%d);\n",SAMPLING_FREQ/2,N_SAMPLE_POINTS/2+1); // Fs/2 ,L/2 
    fprintf(f,"figure(1)\n");
    fprintf(f,"plot(t,xre)\n");
    fprintf(f,"figure(2)\n");
    fprintf(f,"plot(f,P(1:%d))\n",N_SAMPLE_POINTS/2+1);
    fclose(f);


    return 0;
}
